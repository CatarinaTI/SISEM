VERSION "HIPBNYYYYYYYYYYYYYYYYYYYYYYYYYYYYYYYYYYYYY/4/%%%/4/'%**4YYY///"

NS_ :

BS_:

BU_: MICRO USER

BO_ 27 Get_Led1_Status: 8 MICRO

BO_ 28 Set_Led1_Status: 8 USER
 SG_ OnOff : 0|8@1+ (1,0) [0|0] "" Vector__XXX

BO_ 26 Temp_Hum: 8 MICRO
 SG_ Hum : 32|32@1- (1,0) [-100|100] "" Vector__XXX
 SG_ Temp : 0|32@1- (0.1,0) [0|0] "" Vector__XXX
